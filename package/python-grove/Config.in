## package/python-grove/Config.in
```kconfig
config BR2_PACKAGE_PYTHON_GROVE
	bool "python-grove"
	depends on BR2_arm
	depends on BR2_PACKAGE_PYTHON
	depends on BR2_PACKAGE_PYTHON_SMBUS2 # runtime
	select BR2_PACKAGE_PYTHON_RPI_GPIO # runtime
	select BR2_PACKAGE_PYTHON_SETUPTOOLS # runtime
	help
	  A simple tool to access grove sensors on a Raspberry Pi.

	  https://github.com/sa2257/grove.py
```

## package/python-smbus2/Config.in
```kconfig
config BR2_PACKAGE_PYTHON_SMBUS2
	bool "python-smbus2"
	select BR2_PACKAGE_PYTHON
	help
	  This Python module allows SMBus access through the I2C /dev
	  interface on Linux hosts. The host kernel must have I2C
	  support, I2C device interface support, and a bus adapter
	  driver.

	  https://pypi.org/project/smbus2/
```
